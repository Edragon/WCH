
#include<reg51.h>
#include "CH375INC.H"

sbit CH375_INT=P3^2;  //CH375中断信号输出端，低电平输出
sbit CH375_CS=P3^3;   //CH375片选控制端，低电平有效，芯片内置上拉电阻
sbit CH375_RD=P3^4;   //CH375读控制端，低电平有效，芯片内置上拉电阻
sbit CH375_WR=P3^5;   //CH375写控制端，低电平有效，芯片内置上拉电阻
sbit CH375_A0=P3^6;   //CH375命令/数据选择控制端，低电平时写数据，高电平时写命令

/***********************************************************************************
****函数名称：不准确的延时2US的函数
****函数作用：
****函数描述：
************************************************************************************/
void delay2us(void)
{
	unsigned char i;
	for(i=0;i<2;i++);
}
/***********************************************************************************
****函数名称：不准确的延时50mS的函数
****函数作用：
****函数描述：
************************************************************************************/
void delay50ms(void)
{
	unsigned char m,n;
	for(m=0;m<200;m++)
		for(n=0;n<250;n++);
}
/***********************************************************************************
****函数名称：CH375写命令函数
****函数作用：向375写指定的命令
****函数描述：具体命令请见375的头文件中的定义
************************************************************************************/
void CH375_WRCMD(unsigned char cmd)
{
	delay2us();
	P0=cmd;
	CH375_A0=1;
	CH375_RD=1;
	CH375_CS=0;
	CH375_WR=0;
	CH375_WR=1;
	CH375_CS=1;
	CH375_A0=0;
	
	P0=0xFF;          //单片机的端口全部拉高
	delay2us();
}
/***********************************************************************************
****函数名称：CH375写数据函数
****函数作用：向375写指定的数据
****函数描述：
************************************************************************************/
void CH375_WRDAT(unsigned char dat)
{
	P0=dat;
	
	CH375_A0=0;
	CH375_CS=0;
	CH375_WR=0;
	//CH375_CS=0;     //延时用，因为单片机运行比较慢，可省略，运算快的处理器不可省略
	CH375_WR=1;
	CH375_CS=1;
	
	P0=0xFF;         //单片机的端口全部拉高
	
}
/***********************************************************************************
****函数名称：从CH375读数据函数
****函数作用：从375的缓冲区中读取受到的数据
****函数描述：返回读到的数据
************************************************************************************/
unsigned char CH375_REDAT(void)
{
	unsigned char temp;
	P0=0xFF;         //单片机的端口全部拉高
	
	CH375_A0=0;
	CH375_CS=0;
	CH375_RD=0;
	temp=P0;
	CH375_RD=1;
	CH375_CS=1;
	
	P0=0xFF;         //单片机的端口全部拉高
	
	return temp;
}
/***********************************************************************************
****函数名称：外部中断0的响应函数
****函数作用：通过判断375的终端类型值进行相应的处理
****函数描述：
************************************************************************************/
void int0(void) interrupt 0 using 0
{
	unsigned char i,temp,length;
	unsigned char data buf[64];                   //接受到的数据存放的缓冲数组，64个位置
	
	CH375_WRCMD(CMD_GET_STATUS);               //发获取375的中断类型（状态）命令，并取消中断信号
	
	temp=CH375_REDAT();                        //读取中断类型（状态）值
	
	switch(temp)                                  //判断中断类型（状态），具体区分请见375头文件中的定义
	{
		case USB_INT_EP2_OUT:   
			                                     //如果是0x02，则是端点2的OUT事务（接收到数据，OUT成功），OUT是相对于主机端计算机来说的
			CH375_WRCMD(CMD_RD_USB_DATA);      //发读取USB缓冲区数据命令，并释放缓冲区
			length=CH375_REDAT();              //先读取数据长度
			for(i=0;i<length;i++)                 //根据数据长度，读取所有值
			{
				buf[i]=CH375_REDAT();                //读取的数据放入缓冲数组
			}
			
			/*以下为向主机端计算机发送接收到的数据*/
			CH375_WRCMD(CMD_WR_USB_DATA7);     //发向端点2的发送缓冲区写数据命令
			CH375_WRDAT(length);               //先写入数据的长度
			for(i=0;i<length;i++)                 //根据长度，依次发送要发送的数据
				CH375_WRDAT(~buf[i]);
			break;                               //跳出
			
		case USB_INT_EP2_IN:                     //如果是0x0A，则是端点2的IN事务（发送完数据，IN成功），IN是相对于主机端计算机来说的                  
			
			CH375_WRCMD(CMD_UNLOCK_USB);	     //发送释放缓冲区命令
			
			break;                               //跳出
		default:                                 
			CH375_WRCMD(CMD_UNLOCK_USB);	
			break;
	}
}
/***********************************************************************************
****函数名称：主函数
****函数作用：
****函数描述：
************************************************************************************/
void main(void)
{
	unsigned char i;
	delay50ms();                              //延时50ms    
	
	//注释掉的胃测试硬件是否正确，实际应用中可以不用
    //CH375_WRCMD(CMD_CHECK_EXIST);
	//CH375_WRDAT(0x01);
	//i=~0x01;
    //if(CH375_REDAT()==i)
	//P1=i;
	//else
    //P1=0;
	
	
	CH375_WRCMD(CMD_SET_USB_MODE);           //设置工作模式
	CH375_WRDAT(2);                          //设置为内置固件模式
	IT0=0;                                      //设置外部中断0为低电平出发方式
	EX0=1;                                      //使能外部中断0
	EA=1;                                       //使能所有中断
	while(1);                                   //等待
}