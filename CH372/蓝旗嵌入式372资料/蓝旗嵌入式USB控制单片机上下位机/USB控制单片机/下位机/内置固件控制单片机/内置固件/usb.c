
#include "include.h"
/***********************************************************************************
****函数名称：数据收发缓冲区定义
****函数作用：
****函数描述：
************************************************************************************/
unsigned char idata RDataBuf[64];//定义接收缓存区
unsigned char idata TDataBuf[64];//定义发送缓存区
/***********************************************************************************
****函数名称：单片机外设接口定义
****函数作用：
****函数描述：
************************************************************************************/
sbit D0=P1^0;//LED
sbit D1=P1^1;
sbit D2=P1^2;
sbit D3=P1^3;
sbit D4=P1^4;
sbit D5=P1^5;
sbit D6=P1^6;
sbit D7=P1^7;
sbit BEEP=P3^6;//蜂鸣器
unsigned char frq=0;//鸣叫的频率
unsigned char num;


/***********************************************************************************
****函数名称：蜂鸣器初始化函数
****函数作用：
****函数描述：
************************************************************************************/
void BEEPInit()
{
	frq=50;
	EA=1;
	ET0=0;
	TMOD=0x01;
	TH0=0xfe;
	TL0=frq%256;
	TR0=1;
}
/***********************************************************************************
****函数名称：外部中断0的响应函数
****函数作用：通过判断375的终端类型值进行相应的处理
****函数描述：
************************************************************************************/
void int0(void) interrupt 0 using 0
{
	unsigned char i,temp,length;
	//unsigned char data buf[64];                   //接受到的数据存放的缓冲数组，64个位置
	
	CH375_WRCMD(CMD_GET_STATUS);               //发获取375的中断类型（状态）命令，并取消中断信号
	
	temp=CH375_REDAT();                        //读取中断类型（状态）值
	
	switch(temp)                                  //判断中断类型（状态），具体区分请见375头文件中的定义
	{
		case USB_INT_EP2_OUT:   
			                                     //如果是0x02，则是端点2的OUT事务（接收到数据，OUT成功），OUT是相对于主机端计算机来说的
			CH375_WRCMD(CMD_RD_USB_DATA);      //发读取USB缓冲区数据命令，并释放缓冲区
			length=CH375_REDAT();              //先读取数据长度
			for(i=0;i<length;i++)                 //根据数据长度，读取所有值
			{
				RDataBuf[i]=CH375_REDAT();                //读取的数据放入缓冲数组
			}
			
			break;                               //跳出
			
		case USB_INT_EP2_IN:                     //如果是0x0A，则是端点2的IN事务（发送完数据，IN成功），IN是相对于主机端计算机来说的                  
			
			CH375_WRCMD(CMD_UNLOCK_USB);	     //发送释放缓冲区命令
			
			break;                               //跳出
		default:                                 
			CH375_WRCMD(CMD_UNLOCK_USB);	
			break;
	}
}
/***********************************************************************************
****函数名称：蜂鸣器鸣叫函数
****函数作用：
****函数描述：
************************************************************************************/
void Timer0(void) interrupt 1 using 1
{
	TH0=0xfe;
	TL0=frq%256;
	BEEP=~BEEP;
}
/***********************************************************************************
****函数名称：LED控制函数
****函数作用：
****函数描述：
************************************************************************************/
void LEDControl(void)
{
	switch (RDataBuf[5])
	{
		case 0x00:
			D0=RDataBuf[6];
			break;
		case 0x01:
			D1=RDataBuf[6];
			break;
		case 0x02:
			D2=RDataBuf[6];
			break;
		case 0x03:
			D3=RDataBuf[6];
			break;
		case 0x04:
			D4=RDataBuf[6];
			break;
		case 0x05:
			D5=RDataBuf[6];
			break;
		case 0x06:
			D6=RDataBuf[6];
			break;
		case 0x07:
			D7=RDataBuf[6];
			break;
		case 0x08:
			P1=0x00;
			break;
		case 0x09:
			P1=0xff;
			break;
		default:
			break;
	}
}
/***********************************************************************************
****函数名称：蜂鸣器鸣叫函数
****函数作用：
****函数描述：
************************************************************************************/
void BEEPControl(void)
{
	switch(RDataBuf[5])
	{
		case 0x00:
			ET0=0;
			break;
		case 0x01:
			ET0=1;
			frq=RDataBuf[6];
			break;
		default:
			break;
	}
}
/***********************************************************************************
****函数名称：主函数
****函数作用：
****函数描述：
************************************************************************************/
void main(void)
{
	unsigned char i;
	delay50ms();                              //延时50ms    
	
	//注释掉的胃测试硬件是否正确，实际应用中可以不用
   /* CH375_WRCMD(CMD_CHECK_EXIST);
	CH375_WRDAT(0x01);
	i=~0x01;
    if(CH375_REDAT()==i)
	P1=i;
	else
    P1=0;
	*/
	CH375_WRCMD(CMD_SET_USB_MODE);           //设置工作模式
	CH375_WRDAT(2);                          //设置为内置固件模式
	IT0=0;                                      //设置外部中断0为低电平出发方式
	EX0=1;                                      //使能外部中断0
	EA=1;                                       //使能所有中断
	BEEPInit();
	while(1)                                   //等待
	{
		if(RDataBuf[0]==0x00)
		{
			switch(RDataBuf[4])
			{
				case 0x00:
					LEDControl();
					break;
				case 0x01:
					BEEPControl();
					break;
			}
		}
	}
}







