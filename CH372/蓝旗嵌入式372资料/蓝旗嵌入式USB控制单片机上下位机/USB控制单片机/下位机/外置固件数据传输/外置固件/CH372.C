#include "include.h"

sbit CH375_INT=P3^2;  //CH375中断信号输出端，低电平输出
sbit CH375_CS=P3^3;   //CH375片选控制端，低电平有效，芯片内置上拉电阻
sbit CH375_RD=P3^4;   //CH375读控制端，低电平有效，芯片内置上拉电阻
sbit CH375_WR=P3^5;   //CH375写控制端，低电平有效，芯片内置上拉电阻
sbit CH375_A0=P3^7;   //CH375命令/数据选择控制端，低电平时写数据，高电平时写命令

/***********************************************************************************
****函数名称：不准确的延时2US的函数
****函数作用：
****函数描述：
************************************************************************************/
void delay2us(void)
{
	unsigned char i;
	for(i=0;i<2;i++);
}
/***********************************************************************************
****函数名称：不准确的延时50mS的函数
****函数作用：
****函数描述：
************************************************************************************/
void delay50ms(void)
{
	unsigned char m,n;
	for(m=0;m<200;m++)
		for(n=0;n<250;n++);
}
/***********************************************************************************
****函数名称：CH375写命令函数
****函数作用：向375写指定的命令
****函数描述：具体命令请见375的头文件中的定义
************************************************************************************/
void CH375_WRCMD(unsigned char cmd)
{
	delay2us();
	P0=cmd;
	CH375_A0=1;
	CH375_RD=1;
	CH375_CS=0;
	CH375_WR=0;
	CH375_WR=1;
	CH375_CS=1;
	CH375_A0=0;
	
	P0=0xFF;          //单片机的端口全部拉高
	delay2us();
}
/***********************************************************************************
****函数名称：CH375写数据函数
****函数作用：向375写指定的数据
****函数描述：
************************************************************************************/
void CH375_WRDAT(unsigned char dat)
{
	P0=dat;
	
	CH375_A0=0;
	CH375_CS=0;
	CH375_WR=0;
	//CH375_CS=0;     //延时用，因为单片机运行比较慢，可省略，运算快的处理器不可省略
	CH375_WR=1;
	CH375_CS=1;
	
	P0=0xFF;         //单片机的端口全部拉高
	
}
/***********************************************************************************
****函数名称：从CH375读数据函数
****函数作用：从375的缓冲区中读取受到的数据
****函数描述：返回读到的数据
************************************************************************************/
unsigned char CH375_REDAT(void)
{
	unsigned char temp;
	P0=0xFF;         //单片机的端口全部拉高
	
	CH375_A0=0;
	CH375_CS=0;
	CH375_RD=0;
	temp=P0;
	CH375_RD=1;
	CH375_CS=1;
	
	P0=0xFF;         //单片机的端口全部拉高
	
	return temp;
}