
#include "include.h"

/***********************************************************************************
****函数名称：数据收发缓冲区
****函数作用：
****函数描述：
************************************************************************************/
unsigned char idata RDataBuf[64];//定义接收缓存区
unsigned char idata TDataBuf[64];//定义发送缓存区
/***********************************************************************************
****函数名称：单片机外设接口定义
****函数作用：
****函数描述：
************************************************************************************/
sbit D0=P1^0;//LED
sbit D1=P1^1;
sbit D2=P1^2;
sbit D3=P1^3;
sbit D4=P1^4;
sbit D5=P1^5;
sbit D6=P1^6;
sbit D7=P1^7;
sbit BEEP=P3^6;//蜂鸣器

/***********************************************************************************
****函数名称：发送函数
****函数作用：
****函数描述：
************************************************************************************/
void DataSend(char length)
{
	char i;
	CH375_WRCMD(CMD_WR_USB_DATA7);     //发向端点2的发送缓冲区写数据命令
			CH375_WRDAT(length);               //先写入数据的长度
			for(i=0;i<length;i++)                 //根据长度，依次发送要发送的数据
				CH375_WRDAT(RDataBuf[i]);
}

/***********************************************************************************
****函数名称：外部中断0的响应函数
****函数作用：通过判断375的终端类型值进行相应的处理
****函数描述：
************************************************************************************/
void int0(void) interrupt 0 using 0
{
	unsigned char i,temp,length;
	//unsigned char data buf[64];                   //接受到的数据存放的缓冲数组，64个位置
	
	CH375_WRCMD(CMD_GET_STATUS);               //发获取375的中断类型（状态）命令，并取消中断信号
	
	temp=CH375_REDAT();                        //读取中断类型（状态）值
	
	switch(temp)                                  //判断中断类型（状态），具体区分请见375头文件中的定义
	{
		case USB_INT_EP2_OUT:   
			                                     //如果是0x02，则是端点2的OUT事务（接收到数据，OUT成功），OUT是相对于主机端计算机来说的
			CH375_WRCMD(CMD_RD_USB_DATA);      //发读取USB缓冲区数据命令，并释放缓冲区
			length=CH375_REDAT();              //先读取数据长度
			for(i=0;i<length;i++)                 //根据数据长度，读取所有值
			{
				RDataBuf[i]=CH375_REDAT();                //读取的数据放入缓冲数组
			}
			
			/*以下为向主机端计算机发送接收到的数据*/
			CH375_WRCMD(CMD_WR_USB_DATA7);     //发向端点2的发送缓冲区写数据命令
			CH375_WRDAT(length);               //先写入数据的长度
			for(i=0;i<length;i++)                 //根据长度，依次发送要发送的数据
				CH375_WRDAT(RDataBuf[i]);
			//DataSend(length);
			break;                               //跳出
			
		case USB_INT_EP2_IN:                     //如果是0x0A，则是端点2的IN事务（发送完数据，IN成功），IN是相对于主机端计算机来说的                  
			
			CH375_WRCMD(CMD_UNLOCK_USB);	     //发送释放缓冲区命令
			
			break;                               //跳出
		default:                                 
			CH375_WRCMD(CMD_UNLOCK_USB);	
			break;
	}
}

/***********************************************************************************
****函数名称：主函数
****函数作用：
****函数描述：
************************************************************************************/
void main(void)
{
	unsigned char i;
	delay50ms();                              //延时50ms    
	
	//注释掉的胃测试硬件是否正确，实际应用中可以不用
    CH375_WRCMD(CMD_CHECK_EXIST);
	CH375_WRDAT(0x01);
	i=~0x01;
    if(CH375_REDAT()==i)
	P1=i;
	else
    P1=0;
	
	CH375_WRCMD(CMD_SET_USB_MODE);           //设置工作模式
	CH375_WRDAT(2);                          //设置为内置固件模式
	IT0=0;                                      //设置外部中断0为低电平出发方式
	EX0=1;                                      //使能外部中断0
	EA=1;                                       //使能所有中断

	while(1)                                   //等待
	{
		
	}
}







